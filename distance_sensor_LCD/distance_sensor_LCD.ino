// PROJECT DETAILS;

// AUTHOR: IMRE ABEL
// DATE: 6/6/2025

// THE GOAL OF THIS PROJECT IS TO UTILIZE THE HC-SRO4 (ULTRASONIC SENSOR) COMBINED WITH THE LCD1602 (LIQUID CRYSTAL DISPLAY) TO DISPLAY THE DISTANCE IN FEET MEASURED BY THE ULTRASONIC SENSOR ON THE LCD1602
// BREIF DESCRIPTION BELOW:
// README FOR MORE DETAILED DESCRIPTION
// 1. CONNECT ARUDUINO UNO R3 OR BOARD OF CHOICE TO BREADBOARD FOR POWER AND CONTROL OVER ACCESORIES 
// 2. CONNECT HC-SRO4 ULTRASONIC SENSOR TO ARDUINO FOR CONTROL AND BREADBOARD FOR POWER, 
// 3. CONNECT LCD1602 TO BREADBOARD THEN PROPERLY CONNECT ALL WIRING ENSURING NO BURNOUT OCCURS BY USING 10K OHMS RESISTORS FOR POWER CONTROL 
// 3. (OPTIONAL METHOD WOULD BE TO USE A POTENTIOMETER FOR ON THE FLY POWER CONTROL BUT UNFORTUNATELY I CURRENTLY DO NOT OWN ONE)
// 4. WRITE ALL NECCESARY CODE AS I HAVE BELOW THIS CAN BE TWEAK OFC THERE IS NO ONE WAY TO MAKE THIS PROJECT
// 5. TEST AND ENJOY THE FINAL RESULT =)

// INCLUDE LCD DISPLAY LIBRARIES AND SET CONTROLS TO PINS OF CHOICE
// LiquidCrystal lcd(rs, enable, d4, d5, d6, d7);
#include <LiquidCrystal.h>
LiquidCrystal lcd(12, 11, 5, 4, 3, 2);


// DEFINE YOUR PINS OF CHOICE FOR ULTRASONIC SENSOR HC-SRO4 PINS ECHO AND TRIG
#define TRIG_PIN 9
#define ECHO_PIN 10

// SETUP YOUR VARIABLES 
// LONG DURATION FOR TIME IN MICROSECONDS
long duration;
int distance;
bool isRunning = false;


// SETUP EVERYTHING FOR ULTRASONIC SENSOR HC-SRO4 AND LCD1602
// TRIG_PIN OUTPUT TELLS YOU THIS WILL SEND OUT THE SIGNAL AND ECHO_PIN INPUT WILL RECIEVE THE SIGNAL 
void setup() {
  lcd.begin(16, 2);
  lcd.clear();
  lcd.print("Distance Sensor");
  
pinMode(TRIG_PIN, OUTPUT);
pinMode(ECHO_PIN, INPUT);
Serial.begin(9600);
delay(4000);
Serial.println("Type 's' to start and 'p' to pause sensor");
}


// THIS IS WHERE THE MAIN CODE WILL BE
void loop() {
// DETERMINES IF THE SERIAL HAS RECIEVED ANY DATA THIS IS IMPORTANT AS I SET THE PROJECT UP TO ONLY START WHEN 's' IS PRESSED AND ONLY STOP WHEN 'p' IS PRESSED 
if (Serial.available()){
  char key = Serial.read();
while (Serial.available()) Serial.read();

  if (key == 's'){
    isRunning = true;
    Serial.println("Started");
  }
  else if ( key == 'p' ){
    isRunning = false;
    Serial.println("Paused");
  }
   
  }
// THIS WILL DETERMINE IF THE BOOL isRunning IS TRUE OR FALSE ALSO IMPORTANT AS I SET THIS PROJECT UP TO ONLY PRINT DISTANCE ONTO LCD WHEN isRunning IS TRUE WHICH IS DETERMINED BY THE CHARACTER RECIEVED IN SERIAL
if (!isRunning)return;
// THIS SENDS OUT THE SIGNAL AND WAITS FOR IT TO COME BACK YOU WANT TO DELAY INBETWEEN SENDING AND RECEVING TO ENSURE SENSOR HAS TIME TO RESET RESULTING IN HIGHER EFFICACY  
digitalWrite(TRIG_PIN, LOW);
delayMicroseconds(2);
digitalWrite(TRIG_PIN, HIGH);
delayMicroseconds(10);
digitalWrite(TRIG_PIN, LOW);

// THIS PART OF THE CODE WILL DETERMINE THE DURATION AND CALCULATE THE DISTANCE IN CM THEN CONVERT IT TO FEET 
duration = pulseIn(ECHO_PIN, HIGH);

distance = duration * 0.034 / 2;

float distanceFeet = distance / 30.48;


// THIS PART OF THE IS WHAT PRINTS THE RESULTS TO LCD1602 AND SERIAL MONITOR
if (distance > 1000)
{
  Serial.println("OUT OF RANGE");
}
else
{
Serial.print("Distance: ");
lcd.setCursor(0, 1);
  lcd.print("                "); 
  lcd.setCursor(0, 1);
  lcd.print(distanceFeet);
  lcd.print(" ft");

  delay(500);
Serial.print(distanceFeet);
Serial.println(" ft");

}
delay(200);
}

// THANKS FOR VIEWING MORE ADVANCED PROJECTS TO COME
